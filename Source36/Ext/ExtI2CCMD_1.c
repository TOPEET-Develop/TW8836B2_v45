//I2CCMD example for External CPU
//150626 BKang 

#define TW8836B_ID	0x8A

/*CRC16 (X^16 + X^12 + X^5 + 1) */
CODE WORD crctab[256] = {
    0x0000,  0x1021,  0x2042,  0x3063,  0x4084,  0x50A5,  0x60C6,  0x70E7,
    0x8108,  0x9129,  0xA14A,  0xB16B,  0xC18C,  0xD1AD,  0xE1CE,  0xF1EF,
    0x1231,  0x0210,  0x3273,  0x2252,  0x52B5,  0x4294,  0x72F7,  0x62D6,
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    0x6E17,  0x7E36,  0x4E55,  0x5E74,  0x2E93,  0x3EB2,  0x0ED1,  0x1EF0
};



/*
* INPUT(S):       Command bytes 0 through 3
* OUTPUT(S):      none
* RETURN VALUE:   readed count. or error.
*				  error is biggger than 0x80.
* GLOBALS:        none
*/
#define ERR_1	0xFF01
#define ERR_2	0xFF02
#define ERR_3	0xFF03
#define ERR_4	0xFF04
#define ERR_5	0xFF05
#define ERR_6	0xFF06
#define ERR_7	0xFF07

BYTE TW8836SendI2cCommand(BYTE cmd_len, BYTE *pCommand, BYTE *pResult, BYTE f_crc)
{
	WORD crc_calc, crc_server;
	BYTE value;
	BYTE answer, result_count;
	BYTE max_wait=200;
	BYTE i;

	//we can send max 5 bytes.
	if(cmd_len==0 || cmd_len > 5)
		return ERR_1;

	WriteI2C(TW8836B_ID, 0xFF, 0x00);  //page0
#if 0
	//---check flag register
	data = ReadI2C(TW8836B_ID, 0x009);
	if((data & 0xF0) ==0xB0)
		//I2CCMD server is busy.
		return ERR_2;
#endif
	//--clear flag register
	WriteI2C(TW8836B_ID, 0x09, 0x00); 

	//--send command
	WriteI2C(TW8836B_ID, 0xFF, 0x04);  //page4
	if(f_crc) {
		crc_calc = 0;
		for(i=0; i < cmd_len; i++) {
			value = *pCommand++;
			WriteI2C(TW8836B_ID, 0xFA+i, value);
			crc_calc = (crc_calc << 8) ^ crctab[(crc_calc >>8) ^ (WORD)value];
		}
	}
	else {
		for(i=0; i < cmd_len; i++)
			WriteI2C(TW8836B_ID, 0xFA+i, *pCommand++);
	}
	//--send CRC
	if(f_crc) {
		WriteI2C(TW8836B_ID, 0xF6, (BYTE)(crc_calc >> 8));
		WriteI2C(TW8836B_ID, 0xF7, (BYTE)crc_calc);
	}
	//--send execution
	WriteI2C(TW8836B_ID, 0xFF, 0x00);  //page0
	WriteI2C(TW8836B_ID, 0x0F, 0x50);

	//--wait answer
	for(i=0; i < max_wait; i++) {
		value = ReadI2C(TW8836B_ID, 0x009);
		answer = value & 0xF0;
		result_count = value & 0x0F;
		if(answer == 0xA0) //ACK
			continue;
		if(answer == 0xB0) //Busy					  
			continue;
		if(answer == 0xC0) //CRC					  
			return ERR_3;					  
		if(answer == 0xD0) //Done
			break;					  
		if(answer == 0xE0) //Error					  
			return ERR_4;					  
		if(answer == 0xF0) //Fail
			return ERR_5;					  
		
		OSTimeDly(2);	
	}
	if(i==max_wait) {
		dbprint("TW8836 Command failed.\");
		return ERR_6;
	}
	dbprint("TW8836 Command SUCCESS! at %d passes through 2ms loop. Return byte count = %d.\n",i,result_count);

	if(result_count >= 5)
		return ERR_7;

	//--read result.
	dbprint("TW8836 answer %02x ",value);
	WriteI2C(TW8836B_ID, 0xFF, 0x04);  //page4
	crc_calc = 0;
	crc_calc = (crc_calc << 8) ^ crctab[(crc_calc >>8) ^ (WORD)value];
	for(i=1; i <= result_count; i++) {
		ret_value <<= 8;
		if(i==4)	value = ReadI2C(0xF4);
		else		value = ReadI2C(0xFF-i); //REG4FE,REG4FD,REG4FC
		*pResult++ = value;
		crc_calc = (crc_calc << 8) ^ crctab[(crc_calc >>8) ^ (WORD)value];
		dbprint("%02x ",data);
	}
	dbprint("\n");

	//--read result CRC.
	crc_server = ReadI2C(0xF8);
	crc_server <<= 8;
	crc_server |= ReadI2C(0xF9);
	if(crc_server != crc_calc)
		/* warning..You have a CRC error */		
		result_count |= 0x80;	

	WriteI2C(TW8836B_ID, 0xFF, 0x00);  //page0
	return result_count; //success(0~4)	or ( | 0x80) value.
}
